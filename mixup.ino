/*********************************************
  Program: Somethings with ESP32
  Author: SuperRightHand (Thanh Tu)
  Description: None
  Date: 14/10/2022
  Notes: Uses C++
  Revisions: 14:57 17/10/2022
**********************************************/
#include <Wire.h>
#include <Adafruit_GFX.h>
#include <Adafruit_SSD1306.h>
#include <Arduino.h>
#include <WiFi.h>
#include <SPIFFS.h>
#include <ESPAsyncWebServer.h>
#include <time.h>

const char* ssid = "Meow";
const char* password =  "haimuoingan";

const char* myssid = "Configuration";
const char* mypassword = "youresp32";

AsyncWebServer server(80);
AsyncWebSocket ws("/ws");

// Variable control lamp lighting
bool lapSwitch = 0;
const int lap = 4;
const int alarmPin = 2;

// Variable save of alarms
int indexAlarmClocks = 0;
String alarmClocks;


const char *ntpServer = "pool.ntp.org";     //kết nối tới NTP server
const long gmtOffset_sec = 7;           //Múi giờ
const int daylightOffset_sec = 3600 * gmtOffset_sec;           //

#define SCREEN_WIDTH 128 // OLED display width, in pixels
#define SCREEN_HEIGHT 64 // OLED display height, in pixels

Adafruit_SSD1306 display(SCREEN_WIDTH, SCREEN_HEIGHT, &Wire, -1);

//Bitmap of Bongo Cat
int xx = 32;
int yy = 0;
int tt = 100;
const unsigned char PROGMEM frame0 [] = {0x00, 0x00, 0x00, 0x00, 0x00, 0x00, 0x00, 0x00, 0x00, 0x00, 0x00, 0x00, 0x00,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 0x00, 0x00};
const unsigned char PROGMEM frame1 [] = {0x00, 0x00, 0x00, 0x00, 0x00, 0x00, 0x00, 0x00, 0x00, 0x00, 0x00, 0x00, 0x00,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 0x00, 0x00};
const unsigned char PROGMEM frame2 [] = {0x00, 0x00, 0x00, 0x00, 0x00, 0x00, 0x00, 0x00, 0x00, 0x00, 0x00, 0x00, 0x00,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 0x00, 0x00};
const unsigned char PROGMEM frame3 [] = {0x00, 0x00, 0x00, 0x00, 0x00, 0x00, 0x00, 0x00, 0x00, 0x00, 0x00, 0x00, 0x00,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 0x00, 0x00};
const unsigned char PROGMEM frame4 [] = {0x00, 0x00, 0x00, 0x00, 0x00, 0x00, 0x00, 0x00, 0x00, 0x00, 0x00, 0x00, 0x00,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 0x00, 0x00};
const unsigned char PROGMEM frame5 [] = {0x00, 0x00, 0x00, 0x00, 0x00, 0x00, 0x00, 0x00, 0x00, 0x00, 0x00, 0x00, 0x00,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 0x00, 0x00};
const unsigned char PROGMEM frame6 [] = {0x00, 0x00, 0x00, 0x00, 0x00, 0x00, 0x00, 0x00, 0x00, 0x00, 0x00, 0x00, 0x00,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 0x00, 0x00};
const unsigned char PROGMEM frame7 [] = {0x00, 0x00, 0x00, 0x00, 0x00, 0x00, 0x00, 0x00, 0x00, 0x00, 0x00, 0x00, 0x00,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 0x00, 0x00};
const unsigned char PROGMEM frame8 [] = {0x00, 0x00, 0x00, 0x00, 0x00, 0x00, 0x00, 0x00, 0x00, 0x00, 0x00, 0x00, 0x00,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 0x00, 0x00};
const unsigned char PROGMEM frame9 [] = {0x00, 0x00, 0x00, 0x00, 0x00, 0x00, 0x00, 0x00, 0x00, 0x00, 0x00, 0x00, 0x00,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 0x00, 0x00};
const unsigned char PROGMEM frame10 [] = {0x00, 0x00, 0x00, 0x00, 0x00, 0x00, 0x00, 0x00, 0x00, 0x00, 0x00, 0x00, 0x00,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 0x00, 0x00};
const unsigned char PROGMEM frame11 [] = {0x00, 0x00, 0x00, 0x00, 0x00, 0x00, 0x00, 0x00, 0x00, 0x00, 0x00, 0x00, 0x00,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 0x00, 0x00};
const unsigned char PROGMEM frame12 [] = {0x00, 0x00, 0x00, 0x00, 0x00, 0x00, 0x00, 0x00, 0x00, 0x00, 0x00, 0x00, 0x00,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 0x00, 0x00};
const unsigned char PROGMEM frame13 [] = {0x00, 0x00, 0x00, 0x00, 0x00, 0x00, 0x00, 0x00, 0x00, 0x00, 0x00, 0x00, 0x00,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 0x00, 0x00};
const unsigned char PROGMEM frame14 [] = {0x00, 0x00, 0x00, 0x00, 0x00, 0x00, 0x00, 0x00, 0x00, 0x00, 0x00, 0x00, 0x00,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 0x00, 0x00};
const unsigned char PROGMEM frame15 [] = {0x00, 0x00, 0x00, 0x00, 0x00, 0x00, 0x00, 0x00, 0x00, 0x00, 0x00, 0x00, 0x00,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 0x00, 0x00};
const unsigned char PROGMEM frame16 [] = {0x00, 0x00, 0x00, 0x00, 0x00, 0x00, 0x00, 0x00, 0x00, 0x00, 0x00, 0x00, 0x00,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 0x00, 0x00};
const unsigned char PROGMEM frame17 [] = {0x00, 0x00, 0x00, 0x00, 0x00, 0x00, 0x00, 0x00, 0x00, 0x00, 0x00, 0x00, 0x00,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 0x00, 0x00};
const unsigned char PROGMEM frame18 [] = {0x00, 0x00, 0x00, 0x00, 0x00, 0x00, 0x00, 0x00, 0x00, 0x00, 0x00, 0x00, 0x00,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 0x00, 0x00};
const unsigned char PROGMEM frame19 [] = {0x00, 0x00, 0x00, 0x00, 0x00, 0x00, 0x00, 0x00, 0x00, 0x00, 0x00, 0x00, 0x00,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 0x00, 0x00};

/////////Cat///////////////
void bongoCat() {
    display.clearDisplay();
    display.drawBitmap(xx, yy,frame0,64,64, 1);
    display.display();
    delay(tt);    
    display.clearDisplay();
    display.drawBitmap(xx, yy,frame1,64,64, 1);
    display.display();
    delay(tt);
    display.clearDisplay();
    display.drawBitmap(xx, yy,frame2,64,64, 1);
    display.display();
    delay(tt);
    display.clearDisplay();
    display.drawBitmap(xx, yy,frame3,64,64, 1);
    display.display();
    delay(tt);
    display.clearDisplay();
    display.drawBitmap(xx, yy,frame4,64,64, 1);
    display.display();
    delay(tt);  
    display.clearDisplay();
    display.drawBitmap(xx, yy,frame5,64,64, 1);
    display.display();
    delay(tt);
    display.clearDisplay();
    display.drawBitmap(xx, yy,frame6,64,64, 1);
    display.display();
    delay(tt);
    display.clearDisplay();
    display.drawBitmap(xx, yy,frame7,64,64, 1);
    display.display();
    delay(tt);
    display.clearDisplay();
    display.drawBitmap(xx, yy,frame8,64,64, 1);
    display.display();
    delay(tt);
}

void registerDislay() {
  //Oled
  if(!display.begin(SSD1306_SWITCHCAPVCC, 0x3C)) { // Address 0x3C for 128x64
    Serial.println(F("SSD1306 allocation failed"));
    for(;;);
  }
  display.clearDisplay();
  display.setTextSize(2);
  display.setTextColor(BLACK, WHITE);
  display.setCursor(0, 0);
  display.println("   ESP32  ");
  display.println(" PROJECT  ");
  display.setTextSize(1);
  display.setTextColor(WHITE);
  display.println(" ");
  display.println(" Connecting... ");
  display.display();
  delay(3000);
  bongoCat();  
}

//Hien thi dong ho 
void displayTime() {
  struct tm timeinfo;
  if(!getLocalTime(&timeinfo)){
    Serial.println("Failed to obtain time");
    return;
  }
  //Serial.println(&timeinfo,"%A, %d/%B/%Y %H:%M:%S");
  // We write the number of seconds elapsed 
  delay(500);
  display.clearDisplay();
  display.setTextSize(1);
  display.setTextColor(WHITE);
  display.setCursor(0, 0);
  // Display static text
  display.println(" ");
  display.setTextSize(1);
  display.setTextColor(BLACK, WHITE);
  display.println("   Anh em mai dinh  ");
  display.setTextSize(1);
  display.setTextColor(WHITE);
  display.println(" ");
  display.println(&timeinfo, "   %A  ");
  display.println(&timeinfo, "  %d/%B/%Y ");
  display.display(); 
  //display.startscrollright(0x00,0x0F);
  //delay(100);
  //Display hour
  display.setTextSize(2);
  display.setTextColor(WHITE);
  display.setCursor (0, 48);
  display.println(&timeinfo, " %H:%M:%S");
  display.display();
  delay(500);
  display.clearDisplay();
}

////////////////////////////////////////////////////////////////////

//  Handle WebServer

////////////////////////////////////////////////////////////////////

void handleConvertDataTimesFromClient(uint8_t *data, size_t len) {
  alarmClocks = (char*)data;
  indexAlarmClocks = (len + 1) / 6;
}

String convertLapSwitch() {
    return (lapSwitch == 1) ? "true" : "false";   
}



void handleLapSwitch(uint8_t *data) { 
  if (strcmp((char*)data, "true") == 0) {
    lapSwitch = 1;
  }
  else lapSwitch = 0;    
   digitalWrite(lap, lapSwitch);
}

void handleWebSocketMessage(void *arg, uint8_t *data, size_t len) {
  AwsFrameInfo *info = (AwsFrameInfo*)arg;
  if (info->final && info->index == 0 && info->len == len && info->opcode == WS_TEXT) {
    data[len] = 0;
    Serial.println((char*) data); 
    if (strcmp((char*)data, "true") == 0 || strcmp((char*)data, "false") == 0) {
        handleLapSwitch(data);
      }
    else {
       handleConvertDataTimesFromClient(data, len);
      }
  }
}

void handleClientOpenWeb() {
  server.on("/statusSwitch", HTTP_GET, [](AsyncWebServerRequest *request){
    request->send(200, "text/plain", convertLapSwitch());
  });
  server.on("/dataAlarmClock", HTTP_GET, [](AsyncWebServerRequest *request){
    request->send(200, "text/plain", alarmClocks);
  });  
}

void onEvent(AsyncWebSocket *server, AsyncWebSocketClient *client, AwsEventType type,
             void *arg, uint8_t *data, size_t len) {
  switch (type) {
    case WS_EVT_CONNECT:
      Serial.printf("WebSocket client #%u connected from %s\n", client->id(), client->remoteIP().toString().c_str());
      handleClientOpenWeb();
      break;
    case WS_EVT_DISCONNECT:
      Serial.printf("WebSocket client #%u disconnected\n", client->id());
      break;
    case WS_EVT_DATA:
      Serial.println("Case handleData");
      handleWebSocketMessage(arg, data, len);
      break;
    case WS_EVT_PONG:
    case WS_EVT_ERROR:
      break;
  }
}
void initWebSocket() {
  ws.onEvent(onEvent);
  server.addHandler(&ws);
}
////////////////////////////////////////////

//      Program functions

////////////////////////////////////////////

bool checkAlarm() {
  struct tm timeinfo;
  if(!getLocalTime(&timeinfo)){
    Serial.println("Failed to obtain time");
  }
  int hourCheck = timeinfo.tm_hour;
  int minuteCheck = timeinfo.tm_min;
  for (int i = 0; i < indexAlarmClocks; i++) {
      String hourTemp;
      hourTemp = alarmClocks[i*6];
      hourTemp += alarmClocks[1 + i*6];
      String minuteTemp;
      minuteTemp = alarmClocks[3 + i*6];
      minuteTemp += alarmClocks[4 + i*6];
      int hourToInt = hourTemp.toInt();
      int minuteToInt = minuteTemp.toInt();
      if (hourToInt == hourCheck && minuteToInt == minuteCheck) return 1;
  }
  return 0;
}

////////////////////////////////////////////

//      Run program

////////////////////////////////////////////

void setup(){
  Serial.begin(115200);

  if(!SPIFFS.begin()){
     Serial.println("An Error has occurred while mounting SPIFFS");
     return;
  }

  WiFi.begin(ssid, password);

  while (WiFi.status() != WL_CONNECTED) {
    delay(1000);
    Serial.println("Connecting to WiFi..");
  }

  Serial.println(WiFi.localIP());

  pinMode(lap, OUTPUT);
  pinMode(alarmPin, OUTPUT);

  initWebSocket();

  server.on("/", HTTP_GET, [](AsyncWebServerRequest *request){
      request->send(SPIFFS, "/index.html", "text/html");
  });

  server.on("/style.css", HTTP_GET, [](AsyncWebServerRequest *request){
      request->send(SPIFFS, "/style.css", "text/css");
  });

  server.on("/script.js", HTTP_GET, [](AsyncWebServerRequest *request){
      request->send(SPIFFS, "/script.js", "text/javascript");
  });
  
  server.on("/icon.png", HTTP_GET, [](AsyncWebServerRequest *request){
    request->send(SPIFFS, "/icon.png", "image/png");
  });
  handleClientOpenWeb();
 // Start Server
  server.begin();
 // Start Time
  configTime(gmtOffset_sec, daylightOffset_sec, ntpServer);
  registerDislay();
}

void loop() {
  displayTime();
  if (checkAlarm()) {
    digitalWrite(alarmPin, true);
    delay(400);
    digitalWrite(alarmPin, false); 
  }
  ws.cleanupClients();
}
